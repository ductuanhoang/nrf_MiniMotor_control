## CMakeLists.txt
```
# SPDX-License-Identifier: Apache-2.0

cmake_minimum_required(VERSION 3.20.0)

find_package(Zephyr REQUIRED HINTS $ENV{ZEPHYR_BASE})
project(hello_world)

target_sources(app PRIVATE src/main.c src/mini_motor/SparkFunMiniMoto.c)
```

## prj.conf
```kconfig
# nothing here
CONFIG_I2C=y
CONFIG_SENSOR=y
```

## src/main.c
```c
/*
 * Copyright (c) 2012-2014 Wind River Systems, Inc.
 *
 * SPDX-License-Identifier: Apache-2.0
 */

#include <errno.h>
#include <zephyr.h>
#include <sys/printk.h>
#include <device.h>
#include <drivers/i2c.h>
#include "mini_motor/SparkFunMiniMoto.h"
/**
 * @file Sample app using the Fujitsu MB85RC256V FRAM through I2C.
 */


void main(void)
{
	printk("Hello World! %s\n", CONFIG_BOARD);
	mini_motor_init();
	miniMotor_drive(100);
}
```
